## drivers/input/touchscreen/lq/oppo_touchscreen/Focal/Kconfig
```kconfig
source "drivers/input/touchscreen/lq/oppo_touchscreen/Focal/FT8006/Kconfig"
source "drivers/input/touchscreen/lq/oppo_touchscreen/Focal/ft3518/Kconfig"
```

## drivers/input/touchscreen/lq/oppo_touchscreen/Goodix/Kconfig
```kconfig
source "drivers/input/touchscreen/lq/oppo_touchscreen/Goodix/Goodix_gt5688/Kconfig"
source "drivers/input/touchscreen/lq/oppo_touchscreen/Goodix/GT9286/Kconfig"
source "drivers/input/touchscreen/lq/oppo_touchscreen/Goodix/GT9886/Kconfig"
```

## drivers/input/touchscreen/lq/oppo_touchscreen/Kconfig
```kconfig
config TOUCHIRQ_UPDATE_QOS
	default y
	bool "TP TOUCHIRQ_UPDATE enable QOS"
	---help---
	say Y to enable driver for Touchpanel using oppo_touchscreen

config TOUCHPANEL_OPPO
	default y
	bool "TP oppo_touchscreen enable or not for OPPO"
	---help---
	say Y to enable driver for Touchpanel using oppo_touchscreen
	
source "drivers/input/touchscreen/lq/oppo_touchscreen/util_interface/Kconfig"

config TOUCHPANEL_NOVA
	default y
	bool "TP Nova_IC enable or not for OPPO"
	---help---
	say Y to enable driver for Touchpanel using NOVATECK_IC

source "drivers/input/touchscreen/lq/oppo_touchscreen/Novatek/Kconfig"

config TOUCHPANEL_GOODIX
	default y
	bool "TP Goodix_IC enable or not for OPPO"
	---help---
	say Y to enable driver for Touchpanel using GOODIX_IC

source "drivers/input/touchscreen/lq/oppo_touchscreen/Goodix/Kconfig"

config TOUCHPANEL_FOCAL
	default y
	bool "TP FOCAL_IC enable or not for OPPO"
	---help---
	say Y to enable driver for Touchpanel using FOCAL_IC

source "drivers/input/touchscreen/lq/oppo_touchscreen/Focal/Kconfig"
```

## drivers/power/Kconfig
```kconfig
#ifdef VENDOR_EDIT
#/* Yichun.Chen  PSW.BSP.CHG  2019- */
config OPPO_SM6250_CHARGER
	tristate "CONFIG_OPPO_SM6250_CHARGER driver"
	depends on MFD_SPMI_PMIC
	help
	  Enables support for the oppo charging framework

	  
config OPPO_SHORT_C_BATT_CHECK
	tristate "OPPO_SHORT_C_BATT CHECK SUPPORT"
	default n
	depends on MFD_SPMI_PMIC
	help
	  Say Y to include support


config OPPO_SMART_CHARGER_SUPPORT
	bool "OPPO smart charger support"
	help
	  Say Y to include support







config OPPO_RTC_DET_SUPPORT
	tristate "OPPO RTC DET SUPPORT"
	default n
	depends on MFD_SPMI_PMIC
	help
	  Say Y to include support

config OPPO_CHECK_CHARGERID_VOLT
	tristate "OPPO CHECK CHARGERID VOLT"
	default n
	depends on MFD_SPMI_PMIC
	help
	  Say Y to include support

config OPPO_SHIP_MODE_SUPPORT
	tristate "OPPO_SHIP_MODE_SUPPORT"
	default n
	depends on MFD_SPMI_PMIC
	help
	  Say Y to include support

config OPPO_SHORT_IC_CHECK
	tristate "OPPO_SHORT_IC CHECK SUPPORT"
	default n
	depends on MFD_SPMI_PMIC
	help
	  Say Y to include support
	  
config OPPO_SHORT_HW_CHECK
	tristate "OPPO_SHORT_HW CHECK SUPPORT"
	default n
	depends on MFD_SPMI_PMIC
	help
	  Say Y to include support
	  
config OPPO_CHIP_SOC_NODE
	bool "OPPO chip soc node"
	help
	  Say Y to include support
config OPPO_SHORT_USERSPACE
	bool "OPPO batt userspace"
	help
	  Say Y to include support

config OPPO_SMOOTH_SOC
	bool "OPPO SMOOTH SOC "
	help
	  Say Y to include support
	  
config OPPO_CALL_MODE_SUPPORT
	bool "OPPO call mode support"
	help
	  Say Y to include support

source "drivers/power/oppo/Kconfig"
#endif

source "drivers/power/avs/Kconfig"
source "drivers/power/reset/Kconfig"
source "drivers/power/supply/Kconfig"
```

## drivers/soc/oppo/dump_device_info/Kconfig
```kconfig
config OPPO_DUMP_DEVICE_INFO
  bool "config oppo dump device info"
  default y
  help
	define this config to  dump device info.
```
